## components/detection_link/test_apps/target/main/Kconfig.projbuild
```kconfig
menu "Detection link test app"

    config DETECTION_LINK_TEST_QEMU
        bool "Run hardware-independent tests automatically (for QEMU)"
        default n
        help
            QEMU does not emulate the ESP32-C3 Wi-Fi radio, so the [hw] tests cannot run there.
            When enabled, the app runs every other test at boot, prints a summary line and
            stops, instead of showing the interactive test menu.

endmenu
```

## components/mb1013/test_apps/target/main/Kconfig.projbuild
```kconfig
menu "MB1013 test app"

    config MB1013_TEST_QEMU
        bool "Run hardware-independent tests automatically (for QEMU)"
        default n
        help
            QEMU does not emulate the RMT peripheral, so only the decoding tests can run there.
            When enabled, the app runs the [decode] tests at boot, prints a summary line and
            stops, instead of showing the interactive test menu.

endmenu
```

## components/vl53l1x/test_apps/target/main/Kconfig.projbuild
```kconfig
menu "VL53L1X test app"

    config VL53L1X_TEST_QEMU
        bool "Run hardware-independent tests automatically (for QEMU)"
        default n
        help
            QEMU has no VL53L1X on its I2C bus, so only the configuration tests can run there.
            When enabled, the app runs the [config] tests at boot, prints a summary line and
            stops, instead of showing the interactive test menu.

    config VL53L1X_TEST_SDA_GPIO
        int "I2C SDA GPIO"
        default 5
        help
            Default is the Qwiic connector on the SparkFun Pro Micro ESP32-C3.

    config VL53L1X_TEST_SCL_GPIO
        int "I2C SCL GPIO"
        default 6
        help
            Default is the Qwiic connector on the SparkFun Pro Micro ESP32-C3.

    config VL53L1X_TEST_XSHUT_GPIO
        int "XSHUT GPIO"
        default 4

endmenu
```

## main/Kconfig.projbuild
```kconfig
menu "Parking Assistant Indicator"

    config INDICATOR_DETECTOR_MAC
        string "Detector MAC address"
        default ""
        help
            Station MAC address of the detector, as aa:bb:cc:dd:ee:ff. The detector logs it at
            startup. The detector decides which stall this indicator shows from this indicator's
            own MAC address, so every indicator runs the same firmware.

    config INDICATOR_ESPNOW_CHANNEL
        int "ESP-NOW Wi-Fi channel"
        range 1 13
        default 1
        help
            Wi-Fi channel the detector and every indicator use. It must match the detector.

    config INDICATOR_REQUEST_INTERVAL_MS
        int "Time between requests (ms)"
        default 3000
        help
            How often the indicator wakes and asks the detector whether a car is in its stall.
            This is the longest a car waits before the bar lights. Keep it below the detector's
            expected contact interval, or the detector reports this indicator overdue.

    menu "Parking guidance"

        config INDICATOR_GUIDANCE_TIME_MS
            int "How long to show the distance after a car arrives (ms)"
            default 60000
            help
                When the detector first reports a car, the indicator stays awake this long showing
                the lidar distance on the LED bar, then turns the bar off. It does not guide again
                until the detector has reported the stall empty.

        config INDICATOR_GUIDE_DISTANCE_MM
            int "Distance where the whole bar is lit (mm)"
            default 2000
            help
                At this distance or farther the whole bar is green. Closer, the bar shrinks
                linearly to one LED at the stop distance.

        config INDICATOR_STOP_DISTANCE_MM
            int "Stop distance (mm)"
            default 300
            help
                One green LED at this distance; closer than this the whole bar is red. Must be
                less than the distance where the whole bar is lit.

        config INDICATOR_LED_BRIGHTNESS
            int "LED brightness (0-255)"
            range 1 255
            default 64
            help
                Each LED draws up to about 18 mA per colour at 255.

    endmenu

    config INDICATOR_DEEP_SLEEP
        bool "Deep sleep between requests"
        default y
        help
            Sleep between requests to save power. If a PC enumerates the USB port within 2 s of
            power-up, the indicator stays awake anyway until it is next powered up, so it can be
            flashed and its log read. Turn off to stay awake always.

    config INDICATOR_RANGE_BENCH
        bool "Run the range sensor bench test instead"
        default n
        help
            Log the lidar and sonar ranges and step the LED bar through its levels, instead of
            guiding cars in.

endmenu
```
